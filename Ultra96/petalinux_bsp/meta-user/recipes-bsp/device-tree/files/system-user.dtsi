/include/ "system-conf.dtsi"
/ {
};

&spi0 {
        is-decoded-cs = <0>;
        num-cs = <0>;
        status = "okay";
        spidev@0x00 {
                compatible = "spidev";
                spi-max-frequency = <1000000>;
                reg = <0>;
        };
};

&spi0 {
        is-decoded-cs = <0>;
        num-cs = <1>;
        status = "okay";
        spidev@0x00 {
                compatible = "spidev";
                spi-max-frequency = <1000000>;
                reg = <0>;
        };
};

